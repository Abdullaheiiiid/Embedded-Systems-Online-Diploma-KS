#include "STM32F103C6.h"
#include "GPIO.h"
#include "GPIO.c"

void CLOCK_init(){
	//	ENABLE GPIOA
	RCC_GPIOA_ENABLE;
	//	ENABLE GPIOB
	RCC_GPIOB_ENABLE;
}

void GPIO_init(){
	GPIO_PINS_config PIN;
	//	PORTA PIN 0 INPUT FLOATING
	PIN.GPIO_PIN = GPIO_PIN1;
	PIN.GPIO_MODE = GPIO_INPUT_FLOATING;
	PIN.GPIO_SPEED = GPIO_INPUT_SPEED;
	GPIO_INIT(GPIOA, &PIN);

	//	PORTA PIN 13 INPUT FLOATING
	PIN.GPIO_PIN = GPIO_PIN13;
	PIN.GPIO_MODE = GPIO_INPUT_FLOATING;
	PIN.GPIO_SPEED = GPIO_INPUT_SPEED;
	GPIO_INIT(GPIOA, &PIN);

	//	PORTB PIN 0 OUTPUT PUSH PULL
	PIN.GPIO_PIN = GPIO_PIN1;
	PIN.GPIO_MODE = GPIO_OUTPUT_PUSH_PULL;
	PIN.GPIO_SPEED = GPIO_OUTPUT_SPEED_10;
	GPIO_INIT(GPIOB, &PIN);

	//	PORTA PIN 13 OUTPUT PUSH PULL
	PIN.GPIO_PIN = GPIO_PIN13;
	PIN.GPIO_MODE = GPIO_OUTPUT_PUSH_PULL;
	PIN.GPIO_SPEED = GPIO_OUTPUT_SPEED_10;
	GPIO_INIT(GPIOB, &PIN);

}


int main(){
	CLOCK_init();
	GPIO_init();
	while(1){
		//		PA0 IS FLOATING WITH PULL UP RESISTANCE
		if(GPIO_GET_PIN(GPIOA, GPIO_PIN1) == GPIO_PIN_RESET){
			GPIO_TOGGLE_PIN(GPIOB, GPIO_PIN1);
			while(GPIO_GET_PIN(GPIOA, GPIO_PIN1) == GPIO_PIN_RESET);
		}
		//		PA13 IS FLOATING WITH PULL DOWN RESISTANCE
		if(GPIO_GET_PIN(GPIOA, GPIO_PIN13) == GPIO_PIN_SET){
			GPIO_TOGGLE_PIN(GPIOB, GPIO_PIN13);
		}
		_delay_ms(1);
	}
	return 0;
}
