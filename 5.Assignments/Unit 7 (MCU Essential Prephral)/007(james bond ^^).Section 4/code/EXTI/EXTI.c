
#include "EXTI.h"

static volatile void (*GPTF_ISR[3])()={NULL_PTR};

void EXTI_TNIT(EXTI_Pin_config* EXTI_PIN_config){
	switch(EXTI_PIN_config->INT_NUMBER){
	case INT0:
		GPIO_SET_PIN_DIRECTION(EXTI0_PORT, EXTI0_PIN, PIN_INPUT);
		GPIO_SET_PIN_VALUE(GICR, INTE0, LOGIC_HIGH);
		GPIO_SET_PORT_VALUE(MCUCR, (GPIO_GET_PORT_VALUE(MCUCR) & 0xF0) | EXTI_PIN_config->INT_MODE01);
		GPTF_ISR[0] = EXTI_PIN_config->PTF;
		break;
	case INT1:
		GPIO_SET_PIN_DIRECTION(EXTI2_PORT, EXTI1_PIN, PIN_INPUT);
		GPIO_SET_PIN_VALUE(GICR, INTE1, LOGIC_HIGH);
		GPIO_SET_PORT_VALUE(MCUCR, (GPIO_GET_PORT_VALUE(MCUCR) & 0xF0) | EXTI_PIN_config->INT_MODE01);
		GPTF_ISR[1] = EXTI_PIN_config->PTF;
		break;
	case INT2:
		GPIO_SET_PIN_DIRECTION(EXTI2_PORT, EXTI2_PIN, PIN_INPUT);
		GPIO_SET_PIN_VALUE(GICR, INTE2, LOGIC_HIGH);
		GPIO_SET_PIN_VALUE(MCUCSR, ISC2, EXTI_PIN_config->INT_MODE01);
		GPTF_ISR[2] = EXTI_PIN_config->PTF;
		break;
	}

}

void EXTI_GENERAL_ENABLE(){
	GPIO_SET_PIN_VALUE(SREG, GLOBAL_INTE, LOGIC_HIGH);
}
void EXTI_GENERAL_DISABLE(){
	GPIO_SET_PIN_VALUE(SREG, GLOBAL_INTE, LOGIC_LOW);
}

void EXTI_CHANGE_CONFIGURATION(EXTI_Pin_config* EXTI_PIN_config){

}

void EXTI_INSTANCE(EXTI_NUMBER_config INT_NUMBER,EXTI01_TRIGGER_MODE_config INT_MODE01,EXTI2_TRIGGER_MODE_config INT_MODE2,void (*PTF)()){
	EXTI_Pin_config* EXTI_PIN_config;
	EXTI_PIN_config->INT_NUMBER = INT_NUMBER;
	if(INT_MODE2 == NOT_EXTI2 && INT_MODE01 != NOT_EXTI01)
		EXTI_PIN_config->INT_MODE01 = INT_MODE01;
	if(INT_MODE2 != NOT_EXTI2 && INT_MODE01 == NOT_EXTI01)
		EXTI_PIN_config->INT_MODE2 = INT_MODE2;
	EXTI_PIN_config->PTF = PTF;
	EXTI_TNIT(EXTI_PIN_config);
}


// ISR for INT0
void __vector_1(void){
	if(GPTF_ISR[0] != NULL_PTR)
		GPTF_ISR[0]();
}

// ISR for INT2
void __vector_2(void){
	if(GPTF_ISR[1] != NULL_PTR)
		GPTF_ISR[1]();
}

// ISR for INT3
void __vector_3(void){
	if(GPTF_ISR[2] != NULL_PTR)
		GPTF_ISR[2]();
}

