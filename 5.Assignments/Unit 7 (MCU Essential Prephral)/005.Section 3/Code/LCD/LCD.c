//*********************************  LIBRARIES  ******************************//

#include "LCD.h"

//*********************************  LCD APIs  *******************************//

uint8 locx = 0;
uint8 locy = 0;
void _delay_ms(uint32_t time) {
	uint32_t i, j;
	for (i = 0; i < time; i++)
		for (j = 0; j < 255; j++)
			;
}
void LCD_Init(){

	_delay_ms(20);

	GPIO_OUTPUT_PIN(LCD_CTRL_GPIO, LCD_RW_PIN, GPIO_OUTPUT_PUSH_PULL, GPIO_OUTPUT_SPEED_10);
	GPIO_OUTPUT_PIN(LCD_CTRL_GPIO, LCD_RS_PIN, GPIO_OUTPUT_PUSH_PULL, GPIO_OUTPUT_SPEED_10);
	GPIO_OUTPUT_PIN(LCD_CTRL_GPIO, LCD_EN_PIN, GPIO_OUTPUT_PUSH_PULL, GPIO_OUTPUT_SPEED_10);

	GPIO_SET_PIN(LCD_CTRL_GPIO, LCD_RW_PIN, GPIO_PIN_RESET);
	GPIO_SET_PIN(LCD_CTRL_GPIO, LCD_RS_PIN, GPIO_PIN_RESET);
	GPIO_SET_PIN(LCD_CTRL_GPIO, LCD_EN_PIN, GPIO_PIN_RESET);

	_delay_ms(20);
	LCD_Clear_Screen();

#if EIGHT_PINS_MODE

	GPIO_OUTPUT_PIN(LCD_CTRL_GPIO, LCD_DATA0_PIN, GPIO_OUTPUT_PUSH_PULL, GPIO_OUTPUT_SPEED_10);
	GPIO_OUTPUT_PIN(LCD_CTRL_GPIO, LCD_DATA1_PIN, GPIO_OUTPUT_PUSH_PULL, GPIO_OUTPUT_SPEED_10);
	GPIO_OUTPUT_PIN(LCD_CTRL_GPIO, LCD_DATA2_PIN, GPIO_OUTPUT_PUSH_PULL, GPIO_OUTPUT_SPEED_10);
	GPIO_OUTPUT_PIN(LCD_CTRL_GPIO, LCD_DATA3_PIN, GPIO_OUTPUT_PUSH_PULL, GPIO_OUTPUT_SPEED_10);
	GPIO_OUTPUT_PIN(LCD_CTRL_GPIO, LCD_DATA4_PIN, GPIO_OUTPUT_PUSH_PULL, GPIO_OUTPUT_SPEED_10);
	GPIO_OUTPUT_PIN(LCD_CTRL_GPIO, LCD_DATA5_PIN, GPIO_OUTPUT_PUSH_PULL, GPIO_OUTPUT_SPEED_10);
	GPIO_OUTPUT_PIN(LCD_CTRL_GPIO, LCD_DATA6_PIN, GPIO_OUTPUT_PUSH_PULL, GPIO_OUTPUT_SPEED_10);
	GPIO_OUTPUT_PIN(LCD_CTRL_GPIO, LCD_DATA7_PIN, GPIO_OUTPUT_PUSH_PULL, GPIO_OUTPUT_SPEED_10);

	LCD_Send_CMD(EIGHT_BIT_MODE_TWO_LINE);

#elif FOUR_PINS_MODE

	GPIO_OUTPUT_PIN(LCD_CTRL_GPIO, LCD_DATA0_PIN, GPIO_OUTPUT_PUSH_PULL, GPIO_OUTPUT_SPEED_10);
	GPIO_OUTPUT_PIN(LCD_CTRL_GPIO, LCD_DATA1_PIN, GPIO_OUTPUT_PUSH_PULL, GPIO_OUTPUT_SPEED_10);
	GPIO_OUTPUT_PIN(LCD_CTRL_GPIO, LCD_DATA2_PIN, GPIO_OUTPUT_PUSH_PULL, GPIO_OUTPUT_SPEED_10);
	GPIO_OUTPUT_PIN(LCD_CTRL_GPIO, LCD_DATA3_PIN, GPIO_OUTPUT_PUSH_PULL, GPIO_OUTPUT_SPEED_10);

	_delay_ms(40);

	LCD_Send_CMD(FOUR_BIT_MODE);
	LCD_Send_CMD(FOUR_BIT_MODE_TWO_LINE);

#endif

	_delay_ms(40);
	LCD_Send_CMD(ENTRY_MODE);
	LCD_Send_CMD(RESET_CURSOR_FIRST_LINE);
	LCD_Send_CMD(CURSOR_BLINKING);
}

void LCD_Send_CMD(uint8 CMD){

#if EIGHT_PINS_MODE

	GPIO_SET_PORT(LCD_DATA_GPIO, CMD);
	GPIO_SET_PIN(LCD_CTRL_GPIO, LCD_RS_PIN, GPIO_PIN_RESET);
	GPIO_SET_PIN(LCD_CTRL_GPIO, LCD_RW_PIN, GPIO_PIN_RESET);

	LCD_Ready();

#elif FOUR_PINS_MODE

	//	LCD_DATA_PORT = (LCD_DATA_PORT & 0xF0)|(CMD >> 4);

	CMD & GPIO_PIN4 ? GPIO_SET_PIN(LCD_DATA_GPIO, LCD_DATA0_PIN, GPIO_PIN_SET): GPIO_SET_PIN(LCD_DATA_GPIO, LCD_DATA0_PIN, GPIO_PIN_RESET);
	CMD & GPIO_PIN5 ? GPIO_SET_PIN(LCD_DATA_GPIO, LCD_DATA1_PIN, GPIO_PIN_SET): GPIO_SET_PIN(LCD_DATA_GPIO, LCD_DATA1_PIN, GPIO_PIN_RESET);
	CMD & GPIO_PIN6 ? GPIO_SET_PIN(LCD_DATA_GPIO, LCD_DATA2_PIN, GPIO_PIN_SET): GPIO_SET_PIN(LCD_DATA_GPIO, LCD_DATA2_PIN, GPIO_PIN_RESET);
	CMD & GPIO_PIN7 ? GPIO_SET_PIN(LCD_DATA_GPIO, LCD_DATA3_PIN, GPIO_PIN_SET): GPIO_SET_PIN(LCD_DATA_GPIO, LCD_DATA3_PIN, GPIO_PIN_RESET);

	GPIO_SET_PIN(LCD_CTRL_GPIO, LCD_RW_PIN, GPIO_PIN_RESET);
	GPIO_SET_PIN(LCD_CTRL_GPIO, LCD_RS_PIN, GPIO_PIN_RESET);
	LCD_Ready();

	//	LCD_DATA_PORT = (LCD_DATA_PORT & 0xF0)|(CMD & 0x0F);

	CMD & GPIO_PIN0 ? GPIO_SET_PIN(LCD_DATA_GPIO, LCD_DATA0_PIN, GPIO_PIN_SET): GPIO_SET_PIN(LCD_DATA_GPIO, LCD_DATA0_PIN, GPIO_PIN_RESET);
	CMD & GPIO_PIN1 ? GPIO_SET_PIN(LCD_DATA_GPIO, LCD_DATA1_PIN, GPIO_PIN_SET): GPIO_SET_PIN(LCD_DATA_GPIO, LCD_DATA1_PIN, GPIO_PIN_RESET);
	CMD & GPIO_PIN2 ? GPIO_SET_PIN(LCD_DATA_GPIO, LCD_DATA2_PIN, GPIO_PIN_SET): GPIO_SET_PIN(LCD_DATA_GPIO, LCD_DATA2_PIN, GPIO_PIN_RESET);
	CMD & GPIO_PIN3 ? GPIO_SET_PIN(LCD_DATA_GPIO, LCD_DATA3_PIN, GPIO_PIN_SET): GPIO_SET_PIN(LCD_DATA_GPIO, LCD_DATA3_PIN, GPIO_PIN_RESET);

	GPIO_SET_PIN(LCD_CTRL_GPIO, LCD_RW_PIN, GPIO_PIN_RESET);
	GPIO_SET_PIN(LCD_CTRL_GPIO, LCD_RS_PIN, GPIO_PIN_RESET);
	LCD_Ready();

#endif
}
void LCD_Clear_Screen (){
	LCD_GotoXY(0,0);
	LCD_Send_CMD(CLEAR_DISPLAY_CURSOR_DDRAM);
	LCD_Send_CMD(RESET_CURSOR_FIRST_LINE);
}

void LCD_GotoXY(uint8 line, uint8 position ){
	locy = line;
	locx = position;
	if(line == 0){
		if(position <= 15 && position >= 0){
			LCD_Send_CMD(RESET_CURSOR_FIRST_LINE + position);
		}
	}
	else if(line == 1){
		if(position <= 15 && position >= 0){
			LCD_Send_CMD(RESET_CURSOR_SECOND_LINE + position);
		}
	}
}

void LCD_Send_Char(uint8 Data){

	if(locx == 16 && locy == 0){
		locy = 1;
		locx = 0;
	}
	if(locx == 16 && locy == 1){
		locy = 0;
		locx = 0;
	}
	LCD_GotoXY(locy,locx);
	locx++;

#if EIGHT_PINS_MODE

	GPIO_SET_PORT(LCD_DATA_GPIO, Data);
	GPIO_SET_PIN(LCD_CTRL_GPIO, LCD_RS_PIN, GPIO_PIN_SET);
	GPIO_SET_PIN(LCD_CTRL_GPIO, LCD_RW_PIN, GPIO_PIN_RESET);
	LCD_Ready();

#elif FOUR_PINS_MODE

	//	LCD_DATA_PORT = (LCD_DATA_PORT & 0xF0)|(Data >> 4);
	Data & GPIO_PIN4 ? GPIO_SET_PIN(LCD_DATA_GPIO, LCD_DATA0_PIN, GPIO_PIN_SET): GPIO_SET_PIN(LCD_DATA_GPIO, LCD_DATA0_PIN, GPIO_PIN_RESET);
	Data & GPIO_PIN5 ? GPIO_SET_PIN(LCD_DATA_GPIO, LCD_DATA1_PIN, GPIO_PIN_SET): GPIO_SET_PIN(LCD_DATA_GPIO, LCD_DATA1_PIN, GPIO_PIN_RESET);
	Data & GPIO_PIN6 ? GPIO_SET_PIN(LCD_DATA_GPIO, LCD_DATA2_PIN, GPIO_PIN_SET): GPIO_SET_PIN(LCD_DATA_GPIO, LCD_DATA2_PIN, GPIO_PIN_RESET);
	Data & GPIO_PIN7 ? GPIO_SET_PIN(LCD_DATA_GPIO, LCD_DATA3_PIN, GPIO_PIN_SET): GPIO_SET_PIN(LCD_DATA_GPIO, LCD_DATA3_PIN, GPIO_PIN_RESET);

	GPIO_SET_PIN(LCD_CTRL_GPIO, LCD_RS_PIN, GPIO_PIN_SET);
	GPIO_SET_PIN(LCD_CTRL_GPIO, LCD_RW_PIN, GPIO_PIN_RESET);
	LCD_Ready();

	//	LCD_DATA_PORT = (LCD_DATA_PORT & 0xF0)|(Data & 0x0F);
	Data & GPIO_PIN0 ? GPIO_SET_PIN(LCD_DATA_GPIO, LCD_DATA0_PIN, GPIO_PIN_SET): GPIO_SET_PIN(LCD_DATA_GPIO, LCD_DATA0_PIN, GPIO_PIN_RESET);
	Data & GPIO_PIN1 ? GPIO_SET_PIN(LCD_DATA_GPIO, LCD_DATA1_PIN, GPIO_PIN_SET): GPIO_SET_PIN(LCD_DATA_GPIO, LCD_DATA1_PIN, GPIO_PIN_RESET);
	Data & GPIO_PIN2 ? GPIO_SET_PIN(LCD_DATA_GPIO, LCD_DATA2_PIN, GPIO_PIN_SET): GPIO_SET_PIN(LCD_DATA_GPIO, LCD_DATA2_PIN, GPIO_PIN_RESET);
	Data & GPIO_PIN3 ? GPIO_SET_PIN(LCD_DATA_GPIO, LCD_DATA3_PIN, GPIO_PIN_SET): GPIO_SET_PIN(LCD_DATA_GPIO, LCD_DATA3_PIN, GPIO_PIN_RESET);

	GPIO_SET_PIN(LCD_CTRL_GPIO, LCD_RS_PIN, GPIO_PIN_SET);
	GPIO_SET_PIN(LCD_CTRL_GPIO, LCD_RW_PIN, GPIO_PIN_RESET);
	LCD_Ready();

#endif
}

void LCD_Send_String(uint8 *Data){

	uint8 cnt = 0;
	while(*Data > 0){
		cnt++;
		LCD_Send_Char(*Data++);
		if(cnt == 16)
			LCD_GotoXY(1,0);
		else if (cnt == 32){
			LCD_Clear_Screen();
			LCD_GotoXY(0,0);
			cnt = 0;
		}
	}
}

void LCD_Send_Number (sint32 Number ){

	char str[10];
	sprintf(str,"%d",Number);
	LCD_Send_String(str);
}

void LCD_Send_Real_Number (float64 Number ){

	uint8 str[10];
	uint8* sign = (Number < 0) ? "-": "";
	float32 num = (Number < 0) ? -1* Number : Number;
	sprintf(str,"%s%d.%04d",sign,(uint32)num,(uint32)((num - (uint32)num) * 10000));
	LCD_Send_String(str);
}

void LCD_Ready (void){

	GPIO_SET_PIN(LCD_CTRL_GPIO, LCD_EN_PIN, GPIO_PIN_SET);
	_delay_ms(2);
	GPIO_SET_PIN(LCD_CTRL_GPIO, LCD_EN_PIN, GPIO_PIN_RESET);
	_delay_ms(2);
}


